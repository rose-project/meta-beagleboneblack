## conf/layer.conf
```bitbake
# We have a conf and classes directory, add to BBPATH
BBPATH .= ":${LAYERDIR}"

# We have a recipes-* directories, add to BBFILES
BBFILES += "${LAYERDIR}/recipes-*/*/*.bb \
	${LAYERDIR}/recipes-*/*/*.bbappend"

BBFILE_COLLECTIONS += "beagleboneblack"
BBFILE_PATTERN_beagleboneblack = "^${LAYERDIR}/"
BBFILE_PRIORITY_beagleboneblack = "6"

LICENSE_PATH += "${LAYERDIR}/files/additional-licenses"
```

## conf/machine/beagleboneblack.conf
```bitbake
DEFAULTTUNE ?= "cortexa8thf-neon"
require conf/machine/include/tune-cortexa8.inc

MACHINE_EXTRA_RRECOMMENDS = "kernel-modules"

KERNEL_IMAGETYPE = "zImage"
KERNEL_DEVICETREE = "am335x-boneblack.dtb"

UBOOT_SUFFIX = "img"
UBOOT_MACHINE = "am335x_boneblack_config"
UBOOT_ENTRYPOINT = "0x80008000"
UBOOT_LOADADDRESS = "0x80008000"

EXTRA_IMAGEDEPENDS += "u-boot u-boot-env"

SERIAL_CONSOLE = "115200 ttyO0"

IMAGE_FSTYPES += "wic.gz"
IMAGE_BOOT_FILES += "MLO u-boot.img uEnv.txt ${KERNEL_DEVICETREE} ${KERNEL_IMAGETYPE}"

MACHINE_FEATURES = "ext2 serial usbgadget usbhost vfat"

PREFERRED_PROVIDER_virtual/kernel ?= "linux-stable"
PREFERRED_VERSION_virtual/kernel ?= "4.14%"
```

## recipes-core/images/bsp-image-beagleboneblack/beagleboneblack-sdimage.wks
```
part /boot --source=bootimg-partition --ondisk=mmcblk0 --fstype=vfat --label=boot --active --align=1024 --size=64M
part / --source=rootfs --ondisk=mmcblk0 --fstype=ext4 --label=root --align=1024 --size=1024M
```
